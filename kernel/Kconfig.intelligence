## kernel/Kconfig.intelligence
```kconfig
menu "Intelligence"

config INTELLIGENCE
	bool "Intelligent Resource Management"
	depends on FAIR_GROUP_SCHED
	default n
	---help---
	  Enable support for the Intelligence platform

endmenu
```
