/*
 * SAMSUNG EXYNOS9820 board device tree source
 *
 * Copyright (c) 2018 Samsung Electronics Co., Ltd.
 *		http://www.samsung.com
 *
 * This program is free software; you can redistribute it and/or modify
 * it under the terms of the GNU General Public License version 2 as
 * published by the Free Software Foundation.
*/

/dts-v1/;
/plugin/;
#include "exynos9820-maestro9820_common.dtsi"
#include "exynos9820-display-lcd.dtsi"

/ {
	compatible = "samsung,exynos9820", "samsung,MAESTRO9820";
	board_id = <0xF1>;
	board_rev = <0x2>;

	fragment@model {
		target-path = "/";
		__overlay__ {
			#address-cells = <2>;
			#size-cells = <1>;

			model = "Samsung Maestro9820 5G board based on EXYNOS9820";

			ifconn {
				status = "okay";
				compatible = "samsung,ifconn";
				ifconn,usbpd = "s2mm005";
				ifconn,muic = "s2mu004-muic";
			};

		}; /* end of __overlay__ */
	}; /* end of fragment */
}; /* end of root */

&panel_0 {
	/* reset, power */
	gpios = <&gpg3 6 0x1>, <&gpg2 2 0x1>;
};

&fmp_0 {
	exynos,block-type = "sda";
	exynos,fips-block_offset = <5>;
};
